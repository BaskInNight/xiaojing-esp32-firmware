## .codex_backup/fault19_20260730_190932/components/board_config/Kconfig
```kconfig
menu "Xiaojing Configuration"

    choice XIAOJING_OUTPUT_MODE
        prompt "Output mode"
        default XIAOJING_OUTPUT_MODE_FAKE
        help
            FAKE: all outputs simulated, safe for development.
            LOW_VOLTAGE: real GPIO but no mains/24V loads.
            REAL: full hardware output including 220VAC PTC.

        config XIAOJING_OUTPUT_MODE_FAKE
            bool "FAKE (default, safe for development)"

        config XIAOJING_OUTPUT_MODE_LOW_VOLTAGE
            bool "LOW_VOLTAGE (real GPIO, no mains/24V)"

        config XIAOJING_OUTPUT_MODE_REAL
            bool "REAL (full hardware output)"
    endchoice

    config XIAOJING_PTC_ENABLED
        bool "Enable PTC heater (220VAC)"
        default n
        depends on XIAOJING_OUTPUT_MODE_REAL
        help
            PTC heater requires REAL output mode and
            explicit safety confirmation. Keep disabled
            until hardware bring-up T6.

    config XIAOJING_BOARD_IDENTITY_CONFIRMED
        bool "Board identity confirmed (GPIO38/47/48 voltage domain verified)"
        default n
        help
            Must be enabled after verifying the physical board's
            module type (N16R8 vs N16R8V) and GPIO38/47/48 voltage
            domain compatibility. Without this, GPIO38 (FAN_PWM),
            GPIO47 (AMP_SD), and GPIO48 (IBT2_EN) real outputs are
            blocked. Required for LOW_VOLTAGE and REAL output modes.

    config XIAOJING_VOICE_ENABLED
        bool "Enable voice cloud (MiMo)"
        default n
        help
            Enable voice wake-up, VAD recording, HTTPS
            MiMo tool calling and TTS. Requires Wi-Fi
            credentials and API endpoint.

    config XIAOJING_DISPLAY_ENABLED
        bool "Enable LCD display"
        default n
        help
            Enable ILI9341 SPI display adapter for
            status display.

    config XIAOJING_LEGACY_BLE
        bool "Enable legacy BLE protocol"
        default y
        help
            Keep compatibility with old miniapp P/S/A
            compact notifications.

endmenu
```

## .codex_backup/fault19_20260730_190932/sdkconfig.defaults
```kconfig
# 小净 ESP-IDF 默认配置
# Phase 0: 安全基线 — 默认 FAKE 输出，PTC 禁用
# 不要直接编辑 sdkconfig；修改此文件后运行 idf.py set-target esp32s3

# 目标芯片
CONFIG_IDF_TARGET="esp32s3"

# Flash: 16MB, QIO 80MHz
CONFIG_ESPTOOLPY_FLASHSIZE_16MB=y
CONFIG_ESPTOOLPY_FLASHMODE_QIO=y
CONFIG_ESPTOOLPY_FLASHFREQ_80M=y

# 自定义分区表
CONFIG_PARTITION_TABLE_CUSTOM=y
CONFIG_PARTITION_TABLE_CUSTOM_FILENAME="partitions.csv"

# PSRAM: 8MB Octal (OPI) 80MHz
CONFIG_SPIRAM=y
CONFIG_SPIRAM_MODE_OCT=y
CONFIG_SPIRAM_SPEED_80M=y
CONFIG_SPIRAM_BOOT_INIT=y

# NimBLE (BLE 小程序协议)
CONFIG_BT_ENABLED=y
CONFIG_BT_NIMBLE_ENABLED=y

# FreeRTOS
CONFIG_FREERTOS_HZ=100
CONFIG_FREERTOS_CHECK_STACKOVERFLOW_CANARY=y

# Task WDT
CONFIG_ESP_TASK_WDT_EN=y
CONFIG_ESP_TASK_WDT_TIMEOUT_S=10

# 日志默认级别
CONFIG_LOG_DEFAULT_LEVEL_INFO=y

# Coredump: 写入 Flash，ELF 格式，CRC32 校验
# 大小取决于最大任务栈深度（非平均栈），CAPTURE_DRAM 还包含 .bss/.data/heap。
# Phase 0 按 1MiB 保守预算；Phase 10/11 故障注入后再次校准。
CONFIG_ESP_COREDUMP_ENABLE_TO_FLASH=y
CONFIG_ESP_COREDUMP_DATA_FORMAT_ELF=y
CONFIG_ESP_COREDUMP_CHECKSUM_CRC32=y
CONFIG_ESP_COREDUMP_MAX_TASKS_NUM=32
CONFIG_ESP_COREDUMP_CHECK_BOOT=y
CONFIG_ESP_COREDUMP_CAPTURE_DRAM=y
CONFIG_ESP_COREDUMP_LOGS=y
```

## components/bl50_service/Kconfig
```kconfig
menu "BL50 Service Configuration"

    config BL50_SERVICE_TEST_HOOKS
        bool "Enable BL50 service test hooks"
        default n
        help
            Enable test hooks for BL50 service unit testing.
            Must be disabled in production builds.

endmenu
```

## components/ble_transport/Kconfig
```kconfig
menu "BLE Transport Configuration"

    config BLE_TRANSPORT_TEST_HOOKS
        bool "Enable BLE transport test hooks"
        default n
        help
            Enable the fake NimBLE boundary and deterministic failure hooks
            used by the unit-test firmware. Must remain disabled in production.

endmenu
```

## components/board_config/Kconfig
```kconfig
menu "Xiaojing Configuration"

    choice XIAOJING_OUTPUT_MODE
        prompt "Output mode"
        default XIAOJING_OUTPUT_MODE_FAKE
        help
            FAKE: all outputs simulated, safe for development.
            LOW_VOLTAGE: real GPIO but no mains/24V loads.
            REAL: full hardware output including 220VAC PTC.

        config XIAOJING_OUTPUT_MODE_FAKE
            bool "FAKE (default, safe for development)"

        config XIAOJING_OUTPUT_MODE_LOW_VOLTAGE
            bool "LOW_VOLTAGE (real GPIO, no mains/24V)"

        config XIAOJING_OUTPUT_MODE_REAL
            bool "REAL (full hardware output)"
    endchoice

    config XIAOJING_FAKE_RUNTIME_SIM
        bool "Interactive runtime simulation in FAKE mode"
        default n
        depends on XIAOJING_OUTPUT_MODE_FAKE
        help
            Use an executor protocol simulator for phone/BLE testing on a
            bare development board. It never drives REAL or LOW_VOLTAGE
            outputs and is disabled by default for unit-test builds.

    config XIAOJING_PTC_ENABLED
        bool "Enable PTC heater (220VAC)"
        default n
        depends on XIAOJING_OUTPUT_MODE_REAL
        help
            PTC heater requires REAL output mode and
            explicit safety confirmation. Keep disabled
            until hardware bring-up T6.

    config XIAOJING_HOT_AIR_MODULE_ENABLED
        bool "Enable coupled hot-air module (single 220VAC relay)"
        default n
        depends on XIAOJING_OUTPUT_MODE_REAL
        help
            Single-relay coupled hot-air module: the manufacturer wires the
            fixed-speed 220VAC fan and the 220VAC heating element in parallel,
            driven by the SAME relay (MCP GPA7). There is NO independent fan
            or heater control. Requires REAL output mode and explicit safety
            confirmation. The module fan+heater start and stop together.

    config XIAOJING_BOARD_IDENTITY_CONFIRMED
        bool "Board identity confirmed (GPIO38/47/48 voltage domain verified)"
        default n
        help
            Must be enabled after verifying the physical board's
            module type (N16R8 vs N16R8V) and GPIO38/47/48 voltage
            domain compatibility. Without this, GPIO38 (FAN_PWM),
            GPIO47 (AMP_SD), and GPIO48 (IBT2_EN) real outputs are
            blocked. Required for LOW_VOLTAGE and REAL output modes.

    config XIAOJING_VOICE_ENABLED
        bool "Enable voice agent (AI Gateway or MiMo)"
        default n
        help
            Enable voice wake-up, VAD recording, HTTPS
            AUTO_ROUTE/tool calling and TTS. Requires Wi-Fi
            credentials plus a local voice_secrets.h API key.

    config XIAOJING_DISPLAY_ENABLED
        bool "Enable LCD display"
        default n
        help
            Enable ILI9341 SPI display adapter for
            status display.

    config XIAOJING_LEGACY_BLE
        bool "Enable legacy BLE protocol"
        default y
        help
            Keep compatibility with old miniapp P/S/A
            compact notifications.

endmenu
```

## components/detergent_service/Kconfig
```kconfig
menu "Detergent Service"

    config DETERGENT_SERVICE_TEST_HOOKS
        bool "Enable test hooks for detergent service tests"
        default n
        help
            Compile detergent_service.c with hook points for
            deterministic testing. Only enable in test builds.

endmenu
```

## components/drain_service/Kconfig
```kconfig
menu "Drain Service"

    config DRAIN_SERVICE_TEST_HOOKS
        bool "Enable test hooks for drain service tests"
        default n
        help
            Compile drain_service.c with hook points for
            deterministic testing. Only enable in test builds.

endmenu
```

## components/dry_service/Kconfig
```kconfig
menu "Dry Service"

    config DRY_SERVICE_TEST_HOOKS
        bool "Enable test hooks (barrier injection for dry service tests)"
        default n
        help
            Compile dry_service.c with hook points for
            deterministic testing. Only enable in test builds.

endmenu
```

## components/position_service/Kconfig
```kconfig
menu "Position Service"

    config POS_SERVICE_TEST_HOOKS
        bool "Enable test hooks (barrier injection for concurrency tests)"
        default n
        help
            Compile position_service.c with barrier hook points for
            deterministic concurrency testing. Only enable in test builds.

endmenu
```

## components/safety_manager/Kconfig
```kconfig
menu "Safety Manager"

    config SAFETY_MGR_TEST_HOOKS
        bool "Enable test hooks for safety_manager"
        default n
        help
            Compile safety_manager.c with test helper functions
            (test_set_inputs, test_get_inputs, test_reset).
            Only enable in test builds.

endmenu
```

## components/uv_service/Kconfig
```kconfig
menu "UV Service"

    config UV_SERVICE_TEST_HOOKS
        bool "Enable test hooks for UV service tests"
        default n
        help
            Compile uv_service.c with hook points for
            deterministic testing. Only enable in test builds.

endmenu
```

## components/wash_executor/Kconfig
```kconfig
menu "Wash Executor"

    config WASH_EXEC_TEST_HOOKS
        bool "Enable test hooks for wash executor"
        default n
        help
            Enable test hooks that allow injecting events
            and inspecting internal state for testing.

endmenu
```

## components/water_service/Kconfig
```kconfig
menu "Water Service"

    config WATER_SERVICE_TEST_HOOKS
        bool "Enable test hooks (barrier injection for water service tests)"
        default n
        help
            Compile water_service.c with hook points for
            deterministic testing. Only enable in test builds.

endmenu
```

## test_apps/boot_smoke_d_no_psram/sdkconfig.defaults
```kconfig
CONFIG_IDF_TARGET="esp32s3"

# Flash: 16MB QIO 80MHz
CONFIG_ESPTOOLPY_FLASHSIZE_16MB=y
CONFIG_ESPTOOLPY_FLASHMODE_QIO=y
CONFIG_ESPTOOLPY_FLASHFREQ_80M=y

# CPU 160MHz
CONFIG_ESP32S3_DEFAULT_CPU_FREQ_160=y

# NO PSRAM — this is the key isolation variable
CONFIG_SPIRAM=n

# Disable BLE
CONFIG_BT_ENABLED=n

# Minimal stack
CONFIG_ESP_MAIN_TASK_STACK_SIZE=4096

# Disable watchdog for clean baseline
CONFIG_ESP_TASK_WDT_CHECK_IDLE_TASK_CPU0=n
CONFIG_ESP_TASK_WDT_CHECK_IDLE_TASK_CPU1=n
CONFIG_ESP_INT_WDT=n
CONFIG_BOOTLOADER_WDT_ENABLE=n

# Disable coredump
CONFIG_ESP_COREDUMP_ENABLE_TO_NONE=y
```
